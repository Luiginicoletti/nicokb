&i2c0 {
    status = "okay";
    compatible = "nordic,nrf-twim";
    sda-pin = <10>;  // P0.10 (D2)
    scl-pin = <9>;   // P0.09 (D3)

    oled: ssd1306@3c {
        compatible = "solomon,ssd1306fb";
        reg = <0x3c>;
        width = <128>;
        height = <32>;
    };
};
